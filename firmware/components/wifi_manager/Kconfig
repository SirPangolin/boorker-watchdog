## firmware/components/wifi_manager/Kconfig
```kconfig
menu "WiFi Manager"

    config WIFI_MGR_DEVICE_NAME
        string "Device name for mDNS and provisioning"
        default "boorker"
        help
            Used for mDNS (name.local) and BLE advertising name.
            Should be unique on local network.

    config WIFI_MGR_PROV_POP
        string "Proof-of-Possession PIN for BLE provisioning"
        default "boorker123"
        help
            User must enter this PIN in the ESP BLE Prov app.
            CHANGE THIS for production devices!

    config WIFI_MGR_RECONNECT_INITIAL_DELAY_MS
        int "Initial reconnection delay (ms)"
        default 1000
        help
            First retry delay after disconnect

    config WIFI_MGR_RECONNECT_MAX_DELAY_MS
        int "Maximum reconnection delay (ms)"
        default 300000
        help
            Exponential backoff caps at this value (default 5 minutes)

    config WIFI_MGR_RECONNECT_MAX_ATTEMPTS
        int "Maximum reconnection attempts (0 = infinite)"
        default 0
        help
            Number of reconnection attempts before firing
            WIFI_MGR_EVENT_RECONNECT_EXHAUSTED callback.
            Set to 0 for infinite retries (default behavior).

    config WIFI_MGR_ENABLE_POWER_SAVE
        bool "Enable WiFi power saving (modem sleep)"
        default y
        help
            Reduces power consumption when idle.
            Adds slight latency to first packet after idle.

    config WIFI_MGR_ENABLE_MDNS
        bool "Enable mDNS discovery"
        default y
        help
            Register device as <name>.local for easy discovery.

endmenu
```

## firmware/main/Kconfig
```kconfig
menu "Board Configuration"

    config BOARD_VEXT_ENABLED
        bool "Enable Vext power rail"
        default n
        help
            Enable switched 3.3V power rail for external sensors.
            Required for Heltec V3 where sensors are powered from Vext
            (isolated from LoRa/OLED/core on the main 3V3 rail).
            Must be enabled before sensor drivers initialize.

    config BOARD_VEXT_GPIO
        int "Vext control GPIO"
        default 36
        depends on BOARD_VEXT_ENABLED
        range 0 48
        help
            GPIO that controls the Vext power rail.
            Active LOW — P-channel MOSFET. LOW = sensors powered.

endmenu
```

## firmware/sdkconfig.defaults
```kconfig
# Target — both boards are ESP32-S3
CONFIG_IDF_TARGET="esp32s3"
CONFIG_ESPTOOLPY_FLASHSIZE_8MB=y

# Partition table (same layout on both boards)
CONFIG_PARTITION_TABLE_CUSTOM=y
CONFIG_PARTITION_TABLE_CUSTOM_FILENAME="partitions.csv"

# Stack sizes
CONFIG_ESP_MAIN_TASK_STACK_SIZE=8192
CONFIG_FREERTOS_TIMER_TASK_STACK_DEPTH=4096
CONFIG_ESP_TIMER_TASK_STACK_SIZE=4096

# Log level
CONFIG_LOG_DEFAULT_LEVEL_INFO=y

# Console output via UART (CP2102/CP2102N on both boards)
CONFIG_ESP_CONSOLE_UART_DEFAULT=y

# Bluetooth for BLE provisioning
CONFIG_BT_ENABLED=y
CONFIG_BT_BLUEDROID_ENABLED=y
CONFIG_BT_BLE_42_FEATURES_SUPPORTED=y

# TLS Configuration
CONFIG_MBEDTLS_SSL_MAX_CONTENT_LEN=16384
CONFIG_MBEDTLS_CERTIFICATE_BUNDLE=y
CONFIG_MBEDTLS_CERTIFICATE_BUNDLE_DEFAULT_FULL=y

# Network stack (fragmentation for VPN packets)
CONFIG_LWIP_IP4_FRAG=y
CONFIG_LWIP_IP4_REASSEMBLY=y
CONFIG_LWIP_IP6_FRAG=y
CONFIG_LWIP_IP6_REASSEMBLY=y

# HTTP client
CONFIG_ESP_HTTP_CLIENT_ENABLE_HTTPS=y

# LittleFS
CONFIG_LITTLEFS_MAX_PARTITIONS=1
CONFIG_LITTLEFS_PAGE_SIZE=256
CONFIG_LITTLEFS_OBJ_NAME_LEN=64

# HTTPS + NVS encryption (v0.8.2)
# NVS encryption uses nvs_flash_secure_init() directly with nvs_keys partition.
# CONFIG_NVS_ENCRYPTION is NOT set — that enables nvs_sec_provider (HMAC/eFuse).
CONFIG_ESP_HTTPS_SERVER_ENABLE=y
CONFIG_MBEDTLS_X509_CREATE_C=y
CONFIG_MBEDTLS_PEM_WRITE_C=y

# HTTP server (shared defaults — board overlays may override MAX_CONNECTIONS)
CONFIG_HTTP_SERVER_STACK_SIZE=12288

# Tailscale (disabled on all boards)
CONFIG_TS_MGR_ENABLED=n
```

## firmware/sdkconfig.defaults.devkitc
```kconfig
# ESP32-S3-DevKitC-1-N32R8V v1.1
# 32MB Flash, 8MB Octal PSRAM, WS2812 RGB LED

# PSRAM (8MB Octal)
CONFIG_SPIRAM=y
CONFIG_SPIRAM_MODE_OCT=y
CONFIG_SPIRAM_SPEED_80M=y
CONFIG_SPIRAM_BOOT_INIT=y
CONFIG_SPIRAM_USE_MALLOC=y
CONFIG_SPIRAM_MALLOC_ALWAYSINTERNAL=4096
CONFIG_SPIRAM_MALLOC_RESERVE_INTERNAL=32768

# Sensors
CONFIG_DHT22_DEFAULT_GPIO=2
CONFIG_SW420_DEFAULT_GPIO=5

# Buzzer - GPIO6, Timer 0, Channel 4
CONFIG_BUZZER_DRIVER_GPIO=6
CONFIG_BUZZER_DRIVER_LEDC_TIMER=0
CONFIG_BUZZER_DRIVER_LEDC_CHANNEL=4

# Onboard LED - WS2812 on GPIO38 (DevKitC v1.1)
CONFIG_LED_DRIVER_ONBOARD_WS2812=y
CONFIG_LED_DRIVER_ONBOARD_GPIO_NUM=38

# External LED - RGB LEDC on R=9, G=7, B=8
# Physical LED pinout: R(9) - Common(GND) - G(7) - B(8)
CONFIG_LED_DRIVER_EXTERNAL_ENABLED=y
CONFIG_LED_DRIVER_EXTERNAL_RGB_LEDC=y
CONFIG_LED_DRIVER_EXTERNAL_GPIO_R=9
CONFIG_LED_DRIVER_EXTERNAL_GPIO_G=7
CONFIG_LED_DRIVER_EXTERNAL_GPIO_B=8

# HTTPS - 4 connections (has PSRAM, ~8.5MB heap)
CONFIG_HTTP_SERVER_MAX_CONNECTIONS=4

# No Vext on DevKitC — sensors powered from main 3V3
# CONFIG_BOARD_VEXT_ENABLED is not set
```

## firmware/sdkconfig.defaults.heltec_v3
```kconfig
# Heltec WiFi LoRa 32 V3 (V3.2)
# 8MB Flash, no PSRAM, SX1262 LoRa, SSD1306 OLED
# GPIO 8-14 reserved for LoRa, 17/18/21 for OLED

# No PSRAM (512KB SRAM only, ~379KB free heap)
# CONFIG_SPIRAM is not set

# Sensors (same GPIOs as DevKitC — no conflicts on Heltec V3)
CONFIG_DHT22_DEFAULT_GPIO=2
CONFIG_SW420_DEFAULT_GPIO=5

# Buzzer - GPIO6, Timer 0, Channel 4
CONFIG_BUZZER_DRIVER_GPIO=6
CONFIG_BUZZER_DRIVER_LEDC_TIMER=0
CONFIG_BUZZER_DRIVER_LEDC_CHANNEL=4

# Onboard LED - white GPIO on GPIO35
CONFIG_LED_DRIVER_ONBOARD_GPIO=y
CONFIG_LED_DRIVER_ONBOARD_GPIO_NUM=35

# External LED - RGB LEDC on R=4, G=7, B=3
# (GPIO 8,9 are LoRa SX1262 — cannot use DevKitC's R=9,B=8)
CONFIG_LED_DRIVER_EXTERNAL_ENABLED=y
CONFIG_LED_DRIVER_EXTERNAL_RGB_LEDC=y
CONFIG_LED_DRIVER_EXTERNAL_GPIO_R=4
CONFIG_LED_DRIVER_EXTERNAL_GPIO_G=7
CONFIG_LED_DRIVER_EXTERNAL_GPIO_B=3

# HTTPS - 2 connections (no PSRAM, each TLS conn ~40-50KB)
CONFIG_HTTP_SERVER_MAX_CONNECTIONS=2

# Buzzer volumes (50% for audible testing, default 2% is inaudible)
CONFIG_STATUS_BUZZER_VOLUME_CHIRP=50
CONFIG_STATUS_BUZZER_VOLUME_DOUBLE_BEEP=50
CONFIG_STATUS_BUZZER_VOLUME_TRIPLE_BEEP=50
CONFIG_STATUS_BUZZER_VOLUME_ALARM=50
CONFIG_STATUS_BUZZER_VOLUME_SOLID=50

# Vext power rail - GPIO36 controls 3.3V to external sensors
# Active LOW (P-channel MOSFET) — LOW = sensors powered
CONFIG_BOARD_VEXT_ENABLED=y
CONFIG_BOARD_VEXT_GPIO=36
```
