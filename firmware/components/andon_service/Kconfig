## firmware/components/andon_service/Kconfig
```kconfig
menu "ANDON Service"

    config ANDON_MAX_CHANNELS
        int "Maximum number of notification channels"
        default 4
        range 1 8
        help
            Maximum number of channels (LED, buzzer, etc.) that can register
            for ANDON state change notifications.

endmenu
```

## firmware/components/button_driver/Kconfig
```kconfig
menu "Button Driver"

    config BUTTON_DRIVER_MAX_BUTTONS
        int "Maximum registered buttons"
        default 4
        range 1 8
        help
            Maximum number of buttons that can be registered simultaneously.

    config BUTTON_DRIVER_DEBOUNCE_MS
        int "Default debounce period (ms)"
        default 50
        range 10 500
        help
            Default debounce time. Per-button override available at registration.

    config BUTTON_DRIVER_LONG_PRESS_MS
        int "Default long press threshold (ms)"
        default 3000
        range 500 10000
        help
            Default long press detection threshold. Per-button override available.

    config BUTTON_DRIVER_VERY_LONG_PRESS_MS
        int "Default very long press threshold (ms)"
        default 10000
        range 2000 30000
        help
            Default very long press threshold. Per-button override available.
            Set 0xFFFF at registration to disable for a specific button.

    config BUTTON_DRIVER_PRG_GPIO
        int "PRG button GPIO"
        default 0
        range 0 48
        help
            GPIO for the on-board PRG button. Active LOW (internal pull-up).
            Override in board sdkconfig overlay if needed.

endmenu
```

## firmware/components/buzzer_driver/Kconfig
```kconfig
menu "Buzzer Driver"

    config BUZZER_DRIVER_GPIO
        int "Buzzer GPIO pin"
        default 6
        range 0 48
        help
            GPIO pin connected to buzzer signal (I/O pin).

    config BUZZER_DRIVER_LEDC_TIMER
        int "LEDC timer number"
        default 0
        range 0 3
        help
            LEDC timer to use (0-3). LED driver uses timer 1 for external
            RGB LEDC — use timer 0 to avoid conflicts.

    config BUZZER_DRIVER_LEDC_CHANNEL
        int "LEDC channel number"
        default 4
        range 0 7
        help
            LEDC channel to use (0-7). LED driver uses channels 1-3 for
            external RGB LEDC — use channel 4+ to avoid conflicts.

    config BUZZER_DRIVER_PWM_FREQ
        int "PWM frequency (Hz)"
        default 1000
        range 100 10000
        help
            PWM frequency for volume modulation. Does not affect buzzer tone
            (active buzzer has fixed internal frequency).

endmenu
```

## firmware/components/credentials/Kconfig
```kconfig
menu "Credentials"

    config CRED_WEB_PASS_LEN
        int "Web password length"
        default 12
        range 8 32
        help
            Length of auto-generated web password

    config CRED_AP_PASS_LEN
        int "AP password length"
        default 12
        range 8 32
        help
            Length of auto-generated AP password

    config CRED_NAME_PREFIX
        string "Device name prefix"
        default "boorker"
        help
            Prefix for device name (suffix is MAC-derived)

    config CRED_LOG_CREDENTIALS
        bool "Log credentials to serial on first boot"
        default y
        help
            Enable to print generated credentials to serial console.
            Disable for production builds.

endmenu
```

## firmware/components/device_identity/Kconfig
```kconfig
menu "Device Identity"

    config DEVICE_ID_WEB_PASS_LEN
        int "Web password length"
        default 12
        range 8 32
        help
            Length of auto-generated web password

    config DEVICE_ID_AP_PASS_LEN
        int "AP password length"
        default 12
        range 8 32
        help
            Length of auto-generated AP password

    config DEVICE_ID_NAME_PREFIX
        string "Device name prefix"
        default "boorker"
        help
            Prefix for device name (suffix is MAC-derived)

    config DEVICE_ID_LOG_CREDENTIALS
        bool "Log credentials to serial on first boot"
        default y
        help
            Enable to print generated credentials to serial console.
            Disable for production builds.

endmenu
```

## firmware/components/device_state/Kconfig
```kconfig
menu "Device State"

    config DEVICE_STATE_NVS_NAMESPACE
        string "NVS namespace for device state"
        default "dev_state"
        help
            NVS namespace used to persist device lifecycle state
            (claimed status, factory reset, OTA state).

endmenu
```

## firmware/components/dht22_driver/Kconfig
```kconfig
menu "DHT22 Driver"

    config DHT22_DRIVER_ENABLED
        bool "Enable DHT22 driver"
        default y
        help
            Enable the DHT22 temperature/humidity sensor driver.

    config DHT22_DEFAULT_GPIO
        int "Default GPIO for DHT22"
        default 2
        range 0 48
        help
            GPIO pin connected to DHT22 data line.

endmenu
```

## firmware/components/display_driver/Kconfig
```kconfig
menu "Display Driver"

    config DISPLAY_DRIVER_ENABLED
        bool "Enable OLED display"
        default n
        help
            Enable SSD1306 OLED display over I2C. Disable for boards without OLED.

    if DISPLAY_DRIVER_ENABLED

        config DISPLAY_DRIVER_I2C_PORT
            int "I2C port number"
            default 0
            range 0 1
            help
                I2C port (I2C_NUM_0 or I2C_NUM_1).
                Display claims this port. Future I2C sensors should use the other.

        config DISPLAY_DRIVER_I2C_SDA
            int "I2C SDA GPIO"
            default 17
            range 0 48
            help
                I2C data GPIO. Heltec V3: GPIO17 (internal to OLED, not on headers).

        config DISPLAY_DRIVER_I2C_SCL
            int "I2C SCL GPIO"
            default 18
            range 0 48
            help
                I2C clock GPIO. Heltec V3: GPIO18 (internal to OLED, not on headers).

        config DISPLAY_DRIVER_I2C_FREQ
            int "I2C frequency (Hz)"
            default 400000
            help
                I2C bus frequency. SSD1306 supports up to 400kHz.

        config DISPLAY_DRIVER_RST_GPIO
            int "Display reset GPIO"
            default 21
            range -1 48
            help
                GPIO for display hardware reset. Set -1 to disable.
                Heltec V3: GPIO21. Drive HIGH to enable, LOW to reset.

        config DISPLAY_DRIVER_I2C_ADDR
            hex "SSD1306 I2C address"
            default 0x3C
            help
                I2C slave address for SSD1306. Usually 0x3C or 0x3D.

        config DISPLAY_DRIVER_WIDTH
            int "Display width (pixels)"
            default 128
            help
                Horizontal resolution of the OLED panel.

        config DISPLAY_DRIVER_HEIGHT
            int "Display height (pixels)"
            default 64
            range 32 64
            help
                Vertical resolution. SSD1306 supports 128x64 or 128x32.

    endif # DISPLAY_DRIVER_ENABLED

endmenu
```

## firmware/components/event_bus/Kconfig
```kconfig
menu "Event Bus"

    config EVENT_BUS_MAX_CHANNELS
        int "Maximum number of notification channels"
        default 4
        range 1 8
        help
            Maximum number of channels (LED, buzzer, etc.) that can register
            for event state change notifications.

endmenu
```

## firmware/components/http_server/Kconfig
```kconfig
menu "HTTP Server"

    config HTTP_SERVER_HTTPS_ENABLED
        bool "Enable HTTPS (TLS)"
        default y
        help
            Serve web interface over HTTPS with a self-signed certificate.
            When enabled, HTTP on port 80 redirects to HTTPS on port 443.
            Disable only for debugging or constrained environments.

    config HTTP_SERVER_PORT
        int "HTTP port"
        default 80
        range 1 65535

    config HTTP_SERVER_MAX_URI_LEN
        int "Max URI length"
        default 128

    config HTTP_SERVER_MAX_CONNECTIONS
        int "Max concurrent connections"
        default 4
        range 2 7
        help
            Maximum simultaneous client connections. Each HTTPS connection
            uses ~40-50KB of heap. Reduce for boards without PSRAM.

    config HTTP_SERVER_STACK_SIZE
        int "HTTP server task stack size"
        default 12288
        range 8192 16384
        help
            Stack size for HTTP/HTTPS server worker tasks.
            TLS handshakes require more stack than plain HTTP.

endmenu
```

## firmware/components/led_driver/Kconfig
```kconfig
menu "LED Driver"

    choice LED_DRIVER_ONBOARD_TYPE
        prompt "Onboard LED type"
        default LED_DRIVER_ONBOARD_WS2812
        help
            Select the onboard LED hardware type.

        config LED_DRIVER_ONBOARD_WS2812
            bool "WS2812 (addressable RGB)"
        config LED_DRIVER_ONBOARD_GPIO
            bool "Simple GPIO"
        config LED_DRIVER_ONBOARD_NONE
            bool "No onboard LED"
    endchoice

    config LED_DRIVER_ONBOARD_GPIO_NUM
        int "Onboard LED GPIO"
        default 38
        depends on !LED_DRIVER_ONBOARD_NONE
        help
            GPIO pin for onboard LED. DevKitC v1.1 uses GPIO 38.

    config LED_DRIVER_EXTERNAL_ENABLED
        bool "Enable external LED"
        default n
        help
            Enable support for an external LED in addition to onboard.

    if LED_DRIVER_EXTERNAL_ENABLED

        choice LED_DRIVER_EXTERNAL_TYPE
            prompt "External LED type"
            default LED_DRIVER_EXTERNAL_RGB_LEDC

            config LED_DRIVER_EXTERNAL_RGB_LEDC
                bool "RGB LED (3-channel LEDC PWM)"
            config LED_DRIVER_EXTERNAL_MONO_LEDC
                bool "Single color LED (LEDC PWM)"
            config LED_DRIVER_EXTERNAL_GPIO
                bool "Simple GPIO on/off"
        endchoice

        config LED_DRIVER_EXTERNAL_GPIO_R
            int "External LED Red/Data GPIO"
            default 9
            help
                GPIO for red channel (RGB) or data pin (mono/GPIO).

        config LED_DRIVER_EXTERNAL_GPIO_G
            int "External LED Green GPIO"
            default 7
            depends on LED_DRIVER_EXTERNAL_RGB_LEDC
            help
                GPIO for green channel.

        config LED_DRIVER_EXTERNAL_GPIO_B
            int "External LED Blue GPIO"
            default 8
            depends on LED_DRIVER_EXTERNAL_RGB_LEDC
            help
                GPIO for blue channel.

    endif # LED_DRIVER_EXTERNAL_ENABLED

endmenu
```

## firmware/components/led_feedback/Kconfig
```kconfig
menu "LED Feedback"

    config LED_FEEDBACK_ENABLED
        bool "Enable LED status feedback"
        default y
        help
            Master enable for LED status indication.
            Can be overridden at runtime via NVS.

    choice LED_FEEDBACK_TYPE
        prompt "LED hardware type"
        default LED_FEEDBACK_TYPE_LEDC

        config LED_FEEDBACK_TYPE_GPIO
            bool "Simple GPIO (on/off only)"

        config LED_FEEDBACK_TYPE_LEDC
            bool "LEDC PWM (brightness + breathing)"

        config LED_FEEDBACK_TYPE_WS2812
            bool "WS2812 RGB (addressable)"
    endchoice

    config LED_FEEDBACK_GPIO
        int "LED GPIO pin"
        default 38 if IDF_TARGET_ESP32S3
        default 35
        help
            GPIO pin connected to LED.
            DevKitC v1.1: 38 (WS2812), v1.0: 48, Heltec V3: 35 (white)

    config LED_FEEDBACK_DEFAULT_BRIGHTNESS
        int "Default brightness (0-100)"
        default 30
        range 0 100
        depends on !LED_FEEDBACK_TYPE_GPIO
        help
            Default brightness percentage.
            30% recommended to avoid blinding users.

    config LED_FEEDBACK_ACTIVE_LOW
        bool "LED is active-low"
        default n
        help
            Enable if LED turns on when GPIO is LOW.

    config LED_FEEDBACK_BLINK_FAST_MS
        int "Fast blink period (ms)"
        default 400
        help
            Total period for fast blink (half on, half off).

    config LED_FEEDBACK_BLINK_MEDIUM_MS
        int "Medium blink period (ms)"
        default 1000

    config LED_FEEDBACK_BLINK_SLOW_MS
        int "Slow blink period (ms)"
        default 2000

    config LED_FEEDBACK_BREATHE_PERIOD_MS
        int "Breathing cycle period (ms)"
        default 2000
        help
            Full fade-in + fade-out cycle time.

    config LED_FEEDBACK_EXTERNAL_ENABLED
        bool "Enable external LED"
        default n
        help
            Enable a second LED output in addition to the onboard LED.

    choice LED_FEEDBACK_EXTERNAL_TYPE
        prompt "External LED type"
        depends on LED_FEEDBACK_EXTERNAL_ENABLED
        default LED_FEEDBACK_EXTERNAL_TYPE_WS2812

        config LED_FEEDBACK_EXTERNAL_TYPE_GPIO
            bool "Simple GPIO (on/off only)"

        config LED_FEEDBACK_EXTERNAL_TYPE_LEDC
            bool "LEDC PWM (single channel)"

        config LED_FEEDBACK_EXTERNAL_TYPE_RGB_LEDC
            bool "RGB LEDC PWM (3-channel)"

        config LED_FEEDBACK_EXTERNAL_TYPE_WS2812
            bool "WS2812 RGB (addressable)"
    endchoice

    config LED_FEEDBACK_EXTERNAL_GPIO_DATA
        int "External LED data/red GPIO"
        depends on LED_FEEDBACK_EXTERNAL_ENABLED
        default 9
        help
            GPIO for external LED. For RGB_LEDC, this is the red channel.

    config LED_FEEDBACK_EXTERNAL_GPIO_GREEN
        int "External LED green GPIO (RGB_LEDC only)"
        depends on LED_FEEDBACK_EXTERNAL_TYPE_RGB_LEDC
        default 8

    config LED_FEEDBACK_EXTERNAL_GPIO_BLUE
        int "External LED blue GPIO (RGB_LEDC only)"
        depends on LED_FEEDBACK_EXTERNAL_TYPE_RGB_LEDC
        default 7

endmenu
```

## firmware/components/lora_manager/Kconfig
```kconfig
menu "LoRa Manager"

    choice LORA_MANAGER_REGION
        prompt "LoRa region"
        default LORA_REGION_US_915
        help
            Determines default frequency, TX power, and duty cycle limits.
            Individual settings below can override regional defaults.
            Only US_915 has been tested on hardware.

        config LORA_REGION_US_915
            bool "US 915 MHz (FCC, tested)"
        config LORA_REGION_EU_868
            bool "EU 868 MHz (CE, untested)"
        config LORA_REGION_EU_433
            bool "EU 433 MHz (CE, untested)"
        config LORA_REGION_AU_915
            bool "AU 915 MHz (untested)"
    endchoice

    config LORA_MANAGER_TX_POWER_DBM
        int "TX power (dBm)"
        default 22
        range -9 22
        help
            Regional defaults are advisory. If this exceeds the regional
            default, a warning is logged but transmission is not blocked.

    config LORA_MANAGER_SPREADING_FACTOR
        int "Spreading factor"
        default 9
        range 7 12
        help
            Higher = longer range, slower data rate.
            SF7: fastest, shortest range.
            SF12: slowest, longest range.

    config LORA_MANAGER_BANDWIDTH
        int "Bandwidth (0=125kHz, 1=250kHz, 2=500kHz)"
        default 0
        range 0 2
        help
            Narrower = longer range, slower. 125kHz is most common.

    config LORA_MANAGER_CODING_RATE
        int "Coding rate (5=4/5, 6=4/6, 7=4/7, 8=4/8)"
        default 5
        range 5 8
        help
            Higher = more error correction, slower. 4/5 is standard.

    config LORA_MANAGER_PREAMBLE_LENGTH
        int "Preamble length (symbols)"
        default 8
        range 6 65535

    config LORA_MANAGER_DUTY_CYCLE_PCT
        int "Duty cycle limit (%)"
        default 10
        range 1 100
        help
            Duty cycle limit as a percentage of airtime per hour.
            Default: 10%. Lower values are always accepted.
            Capped at the regional legal maximum at runtime.

endmenu
```
