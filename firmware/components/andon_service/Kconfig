## firmware/components/ota_manager/Kconfig
```kconfig
menu "OTA Manager"

    config OTA_MANAGER_CHECK_INTERVAL_HOURS
        int "Background check interval (hours)"
        default 24
        range 1 168
        help
            How often to check GitHub for firmware updates.

    config OTA_MANAGER_DEFAULT_CHANNEL
        int "Default release channel (0=stable, 1=prerelease)"
        default 0
        range 0 1
        help
            0 = stable releases only, 1 = include pre-releases.

    config OTA_MANAGER_ROLLBACK_BOOT_COUNT
        int "Failed boots before rollback"
        default 3
        range 1 10
        help
            Number of consecutive failed boots before automatic rollback
            to the previous firmware.

    config OTA_MANAGER_TASK_STACK_SIZE
        int "OTA task stack size"
        default 8192
        help
            Stack size for the OTA background check task.
            Must be large enough for HTTPS/TLS operations.

    config OTA_MANAGER_HTTP_BUF_SIZE_KB
        int "HTTP response buffer size (KB)"
        default 16
        range 4 64
        help
            Maximum size in kilobytes for HTTP response buffers used by
            OTA operations (GitHub API calls, firmware downloads, and
            local uploads).  Allocated from PSRAM at runtime.

    config OTA_MANAGER_TASK_PRIORITY
        int "OTA task priority"
        default 3
        range 1 24
        help
            FreeRTOS priority for OTA background task.
            Lower than sensors (5) since OTA checks are infrequent.

endmenu
```

## firmware/components/secrets/Kconfig
```kconfig
menu "Secrets"

    config SECRETS_WEB_PASSWORD_LEN
        int "Web password length"
        default 12
        range 8 32

    config SECRETS_AP_PASSWORD_LEN
        int "AP password length"
        default 12
        range 8 32

    config SECRETS_NAME_PREFIX
        string "Device name prefix"
        default "boorker"

    config SECRETS_LOG_ON_BOOT
        bool "Log secrets to serial on first boot"
        default y

endmenu
```

## firmware/components/sensor_manager/Kconfig
```kconfig
menu "Sensor Manager"

    config SENSOR_MANAGER_ENABLED
        bool "Enable Sensor Manager"
        default y
        help
            Enable the sensor manager component.

    config SENSOR_MAX_COUNT
        int "Maximum number of sensors"
        default 8
        range 1 16
        help
            Maximum number of sensors that can be configured.

    config SENSOR_DEFAULT_POLL_MS
        int "Default poll interval (ms)"
        default 5000
        range 2000 300000
        help
            Default polling interval for sensors.
            DHT22 minimum is 2000ms.
            Recommend 30000-60000ms for production.

    config SENSOR_TASK_STACK_SIZE
        int "Sensor task stack size"
        default 4096
        help
            Stack size for the sensor polling task.

    config SENSOR_TASK_PRIORITY
        int "Sensor task priority"
        default 5
        range 1 24
        help
            FreeRTOS priority for sensor polling task.

endmenu
```

## firmware/components/status_buzzer/Kconfig
```kconfig
menu "Status Buzzer"

    config STATUS_BUZZER_ENABLED
        bool "Enable status buzzer"
        default y
        help
            Enable audio feedback via piezo buzzer.

    config STATUS_BUZZER_VOLUME_CHIRP
        int "CHIRP preset volume (%)"
        default 2
        range 0 100
        help
            Volume for CHIRP preset. Default 2% for ear-safe development.

    config STATUS_BUZZER_VOLUME_DOUBLE_BEEP
        int "DOUBLE_BEEP preset volume (%)"
        default 2
        range 0 100

    config STATUS_BUZZER_VOLUME_TRIPLE_BEEP
        int "TRIPLE_BEEP preset volume (%)"
        default 2
        range 0 100

    config STATUS_BUZZER_VOLUME_ALARM
        int "ALARM preset volume (%)"
        default 2
        range 0 100

    config STATUS_BUZZER_VOLUME_SOLID
        int "SOLID preset volume (%)"
        default 2
        range 0 100

endmenu
```

## firmware/components/status_display/Kconfig
```kconfig
menu "Status Display"

    config STATUS_DISPLAY_ENABLED
        bool "Enable OLED status display"
        default n
        help
            Enable SSD1306 OLED display as an ANDON notification channel.
            Uses u8g2 graphics library for rendering.

    if STATUS_DISPLAY_ENABLED

        config STATUS_DISPLAY_I2C_SDA
            int "I2C SDA GPIO"
            default 17
            range 0 48
            help
                I2C data GPIO for OLED. Heltec V3: GPIO17.

        config STATUS_DISPLAY_I2C_SCL
            int "I2C SCL GPIO"
            default 18
            range 0 48
            help
                I2C clock GPIO for OLED. Heltec V3: GPIO18.

        config STATUS_DISPLAY_RST_GPIO
            int "Display reset GPIO (-1 to disable)"
            default 21
            range -1 48
            help
                GPIO for display hardware reset. Heltec V3: GPIO21.
                Set -1 if no reset pin connected.

        config STATUS_DISPLAY_SPLASH_MIN_MS
            int "Splash minimum display time (ms)"
            default 1500
            range 500 5000

        config STATUS_DISPLAY_SPLASH_TIMEOUT_MS
            int "Splash maximum wait for sensors (ms)"
            default 10000
            range 2000 30000

        config STATUS_DISPLAY_ROTATE_INTERVAL_MS
            int "Dashboard auto-rotate interval (ms)"
            default 5000
            range 2000 30000

        config STATUS_DISPLAY_DRILL_TIMEOUT_MS
            int "Drill-down auto-return timeout (ms)"
            default 30000
            range 5000 120000

        config STATUS_DISPLAY_CONTRAST
            int "Default contrast (0-255)"
            default 128
            range 0 255

        config STATUS_DISPLAY_MAX_SENSORS
            int "Max sensors per node"
            default 8
            range 1 16

        config STATUS_DISPLAY_MAX_NODES
            int "Max mesh nodes tracked"
            default 8
            range 1 16

        config STATUS_DISPLAY_TASK_STACK
            int "Display task stack size"
            default 4096
            range 2048 8192

        config STATUS_DISPLAY_TASK_PRIORITY
            int "Display task priority"
            default 3
            range 1 10

        config STATUS_DISPLAY_THROBBER_MS
            int "Splash throbber interval (ms)"
            default 300
            range 100 1000

        config STATUS_DISPLAY_PERSIST_OFF
            bool "Persist display on/off across reboots"
            default n

    endif # STATUS_DISPLAY_ENABLED

endmenu
```

## firmware/components/status_led/Kconfig
```kconfig
menu "Status LED"

    config STATUS_LED_ENABLED
        bool "Enable status LED"
        default y
        help
            Master enable for status LED indication.
            Can be overridden at runtime via NVS.

    choice STATUS_LED_TYPE
        prompt "LED hardware type"
        default STATUS_LED_TYPE_LEDC

        config STATUS_LED_TYPE_GPIO
            bool "Simple GPIO (on/off only)"

        config STATUS_LED_TYPE_LEDC
            bool "LEDC PWM (brightness + breathing)"

        config STATUS_LED_TYPE_WS2812
            bool "WS2812 RGB (addressable)"
    endchoice

    config STATUS_LED_GPIO
        int "LED GPIO pin"
        default 38 if IDF_TARGET_ESP32S3
        default 35
        help
            GPIO pin connected to LED.
            DevKitC v1.1: 38 (WS2812), v1.0: 48, Heltec V3: 35 (white)

    config STATUS_LED_DEFAULT_BRIGHTNESS
        int "Default brightness (0-100)"
        default 30
        range 0 100
        depends on !STATUS_LED_TYPE_GPIO
        help
            Default brightness percentage.
            30% recommended to avoid blinding users.

    config STATUS_LED_ACTIVE_LOW
        bool "LED is active-low"
        default n
        help
            Enable if LED turns on when GPIO is LOW.

    config STATUS_LED_BLINK_FAST_MS
        int "Fast blink period (ms)"
        default 400
        help
            Total period for fast blink (half on, half off).

    config STATUS_LED_BLINK_MEDIUM_MS
        int "Medium blink period (ms)"
        default 1000

    config STATUS_LED_BLINK_SLOW_MS
        int "Slow blink period (ms)"
        default 2000

    config STATUS_LED_BREATHE_PERIOD_MS
        int "Breathing cycle period (ms)"
        default 2000
        help
            Full fade-in + fade-out cycle time.

    config STATUS_LED_EXTERNAL_ENABLED
        bool "Enable external LED"
        default n
        help
            Enable a second LED output in addition to the onboard LED.

    choice STATUS_LED_EXTERNAL_TYPE
        prompt "External LED type"
        depends on STATUS_LED_EXTERNAL_ENABLED
        default STATUS_LED_EXTERNAL_TYPE_WS2812

        config STATUS_LED_EXTERNAL_TYPE_GPIO
            bool "Simple GPIO (on/off only)"

        config STATUS_LED_EXTERNAL_TYPE_LEDC
            bool "LEDC PWM (single channel)"

        config STATUS_LED_EXTERNAL_TYPE_RGB_LEDC
            bool "RGB LEDC PWM (3-channel)"

        config STATUS_LED_EXTERNAL_TYPE_WS2812
            bool "WS2812 RGB (addressable)"
    endchoice

    config STATUS_LED_EXTERNAL_GPIO_DATA
        int "External LED data/red GPIO"
        depends on STATUS_LED_EXTERNAL_ENABLED
        default 9
        help
            GPIO for external LED. For RGB_LEDC, this is the red channel.

    config STATUS_LED_EXTERNAL_GPIO_GREEN
        int "External LED green GPIO (RGB_LEDC only)"
        depends on STATUS_LED_EXTERNAL_TYPE_RGB_LEDC
        default 8

    config STATUS_LED_EXTERNAL_GPIO_BLUE
        int "External LED blue GPIO (RGB_LEDC only)"
        depends on STATUS_LED_EXTERNAL_TYPE_RGB_LEDC
        default 7

endmenu
```

## firmware/components/sw420_driver/Kconfig
```kconfig
menu "SW-420 Vibration Driver"

    config SW420_DRIVER_ENABLED
        bool "Enable SW-420 driver"
        default y
        help
            Enable SW-420 vibration sensor driver.

    config SW420_DEFAULT_GPIO
        int "Default GPIO for SW-420"
        default 5
        range 0 48
        help
            GPIO pin connected to SW-420 DO (digital output).

    config SW420_DEBOUNCE_ON_MS
        int "Debounce ON threshold (ms)"
        default 200
        range 0 5000
        help
            Vibration must sustain this long to register as active.

    config SW420_DEBOUNCE_OFF_MS
        int "Debounce OFF threshold (ms)"
        default 500
        range 0 5000
        help
            Quiet period before reporting idle.

    config SW420_ACTIVE_HIGH
        bool "Active HIGH output"
        default y
        help
            GPIO HIGH = vibrating. Disable if module outputs LOW on vibration.

endmenu
```

## firmware/components/sx1262_driver/Kconfig
```kconfig
menu "SX1262 Driver"

    config SX1262_PIN_NSS
        int "NSS (chip select) GPIO"
        default 8

    config SX1262_PIN_SCK
        int "SCK (SPI clock) GPIO"
        default 9

    config SX1262_PIN_MOSI
        int "MOSI (SPI data out) GPIO"
        default 10

    config SX1262_PIN_MISO
        int "MISO (SPI data in) GPIO"
        default 11

    config SX1262_PIN_RST
        int "RST (radio reset) GPIO"
        default 12

    config SX1262_PIN_BUSY
        int "BUSY (radio busy) GPIO"
        default 13

    config SX1262_PIN_DIO1
        int "DIO1 (radio interrupt) GPIO"
        default 14

    config SX1262_SPI_CLOCK_HZ
        int "SPI clock speed (Hz)"
        default 8000000
        range 1000000 16000000

    config SX1262_TASK_STACK_SIZE
        int "DIO1 handler task stack size"
        default 4096

    config SX1262_TASK_PRIORITY
        int "DIO1 handler task priority"
        default 6
        range 1 24
        help
            Higher than sensors (5) since radio events are time-sensitive.

endmenu
```

## firmware/components/system_console/Kconfig
```kconfig
menu "System Console"

    config SYSTEM_CONSOLE_REBOOT_DEFAULT_DELAY
        int "Default reboot delay (seconds)"
        default 3
        range 0 300
        help
            Default delay before reboot when no argument provided.

    config SYSTEM_CONSOLE_REBOOT_MAX_DELAY
        int "Maximum reboot delay (seconds)"
        default 300
        range 10 3600
        help
            Maximum allowed delay for scheduled reboot.

endmenu
```

## firmware/components/system_state/Kconfig
```kconfig
menu "System State"

    config SYSTEM_STATE_NVS_NAMESPACE
        string "NVS namespace for system state"
        default "sys_state"
        help
            NVS namespace used to persist system lifecycle state
            (claimed status, factory reset, OTA state).

endmenu
```

## firmware/components/tailscale_manager/Kconfig
```kconfig
menu "Tailscale Manager"

    config TS_MGR_ENABLED
        bool "Enable Tailscale VPN"
        default y
        help
            Enable Tailscale VPN connectivity via MicroLink.
            Disable this to run without Tailscale while still
            having local WiFi access to the device.

    config TS_MGR_DEVICE_NAME
        depends on TS_MGR_ENABLED
        string "Default Tailscale device name"
        default "boorker"
        help
            Device name shown in Tailscale admin console.

    config TS_MGR_UPDATE_INTERVAL_MS
        depends on TS_MGR_ENABLED
        int "MicroLink update interval (ms)"
        default 100
        help
            How often to call microlink_update().

    config TS_MGR_RECONNECT_INITIAL_MS
        depends on TS_MGR_ENABLED
        int "Initial reconnection delay (ms)"
        default 5000
        help
            First retry delay after disconnect.

    config TS_MGR_RECONNECT_MAX_MS
        depends on TS_MGR_ENABLED
        int "Maximum reconnection delay (ms)"
        default 300000
        help
            Exponential backoff caps at this value (default 5 minutes).

    config TS_MGR_RECONNECT_MAX_ATTEMPTS
        depends on TS_MGR_ENABLED
        int "Maximum reconnection attempts (0 = infinite)"
        default 0
        help
            Set to 0 for infinite retries (default behavior).

    config TS_MGR_TASK_STACK_SIZE
        depends on TS_MGR_ENABLED
        int "Update task stack size"
        default 8192
        help
            Stack size for the MicroLink update task.

    config TS_MGR_TASK_PRIORITY
        depends on TS_MGR_ENABLED
        int "Update task priority"
        default 5
        help
            FreeRTOS priority for the MicroLink update task.

endmenu
```
